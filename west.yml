## west.yml
```yaml
# Copyright (c) 2025 Demant A/S

manifest:
  remotes:
    - name: zephyrproject-rtos
      url-base: https://github.com/zephyrproject-rtos

  projects:
    - name: zephyr
      remote: zephyrproject-rtos
      revision: 74056a7aedd466b455ec1440c34a79f4e659ddff
      import:
        name-allowlist:
          - cmsis_6
          - hal_nordic
          - mbedtls
          - libmetal
          - open-amp
```
