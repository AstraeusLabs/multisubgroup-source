## CMakeLists.txt
```
# Copyright (c) 2025 Demant A/S
# SPDX-License-Identifier: Apache-2.0

cmake_minimum_required(VERSION 3.20.0)

find_package(Zephyr REQUIRED HINTS $ENV{ZEPHYR_BASE})
project(multisubgroup-source)

FILE(GLOB app_sources src/*.c)
target_sources(app PRIVATE ${app_sources})

set(lc3_dir src/lc3/)
set(gen_dir ${ZEPHYR_BINARY_DIR}/include/generated/)

file(GLOB lc3_files "${lc3_dir}/*.lc3")

foreach(lc3_file ${lc3_files})
    get_filename_component(lc3_filename ${lc3_file} NAME)
    set(output_file "${gen_dir}/${lc3_filename}.inc")

    generate_inc_file_for_target(app ${lc3_file} ${output_file})
endforeach()
```

## Kconfig
```
# Copyright (c) 2025 Demant A/S
# Copyright (c) 2023 Nordic Semiconductor ASA
# SPDX-License-Identifier: Apache-2.0

mainmenu "Bluetooth: Broadcast Audio Source"

choice BT_BAP_AUDIO_SR
    prompt "Audio Sample Rate"
    default BT_BAP_AUDIO_SR_16K

config BT_BAP_AUDIO_SR_16K
    bool "16kHz"

config BT_BAP_AUDIO_SR_24K
    bool "24kHz"

config BT_BAP_AUDIO_SR_48K
    bool "48kHz"

endchoice

choice BT_BAP_AUDIO_CH
    prompt "Audio Channel Mode"
    default BT_BAP_AUDIO_CH_MONO

config BT_BAP_AUDIO_CH_MONO
    bool "Mono"

config BT_BAP_AUDIO_CH_STEREO
    bool "Stereo"

config BT_BAP_AUDIO_CH_LCR
    bool "LCR (Left-Center-Right)"

endchoice

config BROADCAST_CODE
	string "The broadcast code (if any) to use for encrypted broadcast"
	default ""
	help
	   Setting a non-empty string for this option will encrypt the broadcast using this
	   string as the broadcast code. The length of the string shall be between 1 and 16 octets.

source "Kconfig.zephyr"
```

## prj.conf
```kconfig
# Broadcast Audio Source
CONFIG_BT=y
CONFIG_BT_AUDIO=y

CONFIG_BT_BAP_BROADCAST_SOURCE=y
CONFIG_BT_BAP_BROADCAST_SRC_SUBGROUP_COUNT=3
CONFIG_BT_BAP_BROADCAST_SRC_STREAM_COUNT=3

CONFIG_BT_ISO_BROADCASTER=y
CONFIG_BT_ISO_MAX_CHAN=6
CONFIG_BT_ISO_TX_BUF_COUNT=18
CONFIG_BT_ISO_TX_MTU=155

CONFIG_BT_DEVICE_NAME="Broadcast Source"

CONFIG_PWM=y
CONFIG_BT_AUDIO_CODEC_CFG_MAX_METADATA_SIZE=100

CONFIG_BASE64=y

CONFIG_MAIN_STACK_SIZE=8192
CONFIG_LOG=y

# The default sample rate for the source is 16kHz
# Enable one of the following to build for a 24kHz or 48kHz source:
# CONFIG_BT_BAP_AUDIO_SR_24K=y
# CONFIG_BT_BAP_AUDIO_SR_48K=y

# The default channel mode for the source is Mono
# Enable one of the following to build for Stereo or LCR channels:
# CONFIG_BT_BAP_AUDIO_CH_STEREO=y
# CONFIG_BT_BAP_AUDIO_CH_LCR=y
```

## overlay-bt_ll_sw_split.conf
```kconfig
# Zephyr Bluetooth Controller
CONFIG_BT_LL_SW_SPLIT=y

# Zephyr Controller tested maximum advertising data that can be set in a single HCI command
CONFIG_BT_CTLR_ADV_DATA_LEN_MAX=191

# Enable support for Broadcast ISO in Zephyr Bluetooth Controller
CONFIG_BT_CTLR_ADV_ISO=y

# Sufficient ISO PDU length for any BAP LC3 presets (155)
CONFIG_BT_CTLR_ADV_ISO_PDU_LEN_MAX=155

# Number of supported streams
CONFIG_BT_CTLR_ADV_ISO_STREAM_MAX=6
CONFIG_BT_CTLR_ISOAL_SOURCES=6

# Support the highest SDU size required by any BAP LC3 presets (155) + 8 bytes of HCI ISO Data
# packet overhead (the Packet_Sequence_Number, ISO_SDU_Length, Packet_Status_Flag fields; and
# the optional Time_Stamp field, if supplied)
CONFIG_BT_CTLR_ISO_TX_BUFFER_SIZE=163
```

## src/main.c
```c
/*
 * Copyright (c) 2025 Demant A/S
 * Copyright (c) 2022-2023 Nordic Semiconductor ASA
 *
 * SPDX-License-Identifier: Apache-2.0
 */

#include <zephyr/bluetooth/bluetooth.h>
#include <zephyr/bluetooth/addr.h>
#include <zephyr/bluetooth/audio/audio.h>
#include <zephyr/bluetooth/audio/bap.h>
#include <zephyr/bluetooth/audio/bap_lc3_preset.h>
#include <zephyr/drivers/hwinfo.h>
#include <zephyr/sys/base64.h>

#include "lc3_audio.h"
#include "rgb_led.h"


#define NUM_SUBGROUPS	CONFIG_BT_BAP_BROADCAST_SRC_SUBGROUP_COUNT
#define NUM_STREAMS     CONFIG_BT_BAP_BROADCAST_SRC_STREAM_COUNT

/* When BROADCAST_ENQUEUE_COUNT > 1 we can enqueue enough buffers to ensure that
 * the controller is never idle
 */
#define BROADCAST_ENQUEUE_COUNT	   3U
#define TOTAL_BUF_NEEDED           (BROADCAST_ENQUEUE_COUNT * NUM_STREAMS)

/* Zephyr Controller works best while Extended Advertising interval to be a multiple
 * of the ISO Interval minus 10 ms (max. advertising random delay). This is
 * required to place the AUX_ADV_IND PDUs in a non-overlapping interval with the
 * Broadcast ISO radio events.
 *
 * I.e. for a 7.5 ms ISO interval use 90 ms minus 10 ms ==> 80 ms advertising
 * interval.
 * And, for 10 ms ISO interval, can use 90 ms minus 10 ms ==> 80 ms advertising
 * interval.
 */
#define BT_LE_EXT_ADV_CUSTOM	BT_LE_ADV_PARAM(BT_LE_ADV_OPT_EXT_ADV | \
						BT_LE_ADV_OPT_USE_IDENTITY, \
						0x0080, 0x0080, NULL)

/* The following section contains the LC3 broadcast preset configuration
 * based on the Kconfig options
 */
#if defined(CONFIG_BT_BAP_AUDIO_SR_16K)
#define BROADCAST_PRESET_ARG_NAME 	"16_2_1"
#define AUDIO_SAMPLE_RATE		16000
#elif defined(CONFIG_BT_BAP_AUDIO_SR_24K)
#define BROADCAST_PRESET_ARG_NAME 	"24_2_1"
#define AUDIO_SAMPLE_RATE		24000
#elif defined(CONFIG_BT_BAP_AUDIO_SR_48K)
#define BROADCAST_PRESET_ARG_NAME 	"48_2_1"
#define AUDIO_SAMPLE_RATE		48000
#endif

#if defined(CONFIG_BT_BAP_AUDIO_CH_MONO)
#define LOCATION		(BT_AUDIO_LOCATION_MONO_AUDIO)
#define AUDIO_CHANNELS_NUMBER	1
#elif defined(CONFIG_BT_BAP_AUDIO_CH_STEREO)
#define LOCATION		(BT_AUDIO_LOCATION_FRONT_LEFT | \
				 BT_AUDIO_LOCATION_FRONT_RIGHT)
#define AUDIO_CHANNELS_NUMBER	2
#elif defined(CONFIG_BT_BAP_AUDIO_CH_LCR)
#define LOCATION		(BT_AUDIO_LOCATION_FRONT_LEFT | \
				 BT_AUDIO_LOCATION_FRONT_RIGHT | \
				 BT_AUDIO_LOCATION_FRONT_CENTER)
#define AUDIO_CHANNELS_NUMBER	3
#endif

#define CONTEXT                 (BT_AUDIO_CONTEXT_TYPE_UNSPECIFIED)


struct named_lc3_preset {
	const char *name;
	struct bt_bap_lc3_preset preset;
};

static const struct named_lc3_preset lc3_broadcast_presets[] = {
	{"8_1_1", BT_BAP_LC3_BROADCAST_PRESET_8_1_1(LOCATION, CONTEXT)},
	{"8_2_1", BT_BAP_LC3_BROADCAST_PRESET_8_2_1(LOCATION, CONTEXT)},
	{"16_1_1", BT_BAP_LC3_BROADCAST_PRESET_16_1_1(LOCATION, CONTEXT)},
	{"16_2_1", BT_BAP_LC3_BROADCAST_PRESET_16_2_1(LOCATION, CONTEXT)},
	{"24_1_1", BT_BAP_LC3_BROADCAST_PRESET_24_1_1(LOCATION, CONTEXT)},
	{"24_2_1", BT_BAP_LC3_BROADCAST_PRESET_24_2_1(LOCATION, CONTEXT)},
	{"32_1_1", BT_BAP_LC3_BROADCAST_PRESET_32_1_1(LOCATION, CONTEXT)},
	{"32_2_1", BT_BAP_LC3_BROADCAST_PRESET_32_2_1(LOCATION, CONTEXT)},
	{"441_1_1", BT_BAP_LC3_BROADCAST_PRESET_441_1_1(LOCATION, CONTEXT)},
	{"441_2_1", BT_BAP_LC3_BROADCAST_PRESET_441_2_1(LOCATION, CONTEXT)},
	{"48_1_1", BT_BAP_LC3_BROADCAST_PRESET_48_1_1(LOCATION, CONTEXT)},
	{"48_2_1", BT_BAP_LC3_BROADCAST_PRESET_48_2_1(LOCATION, CONTEXT)},
	{"48_3_1", BT_BAP_LC3_BROADCAST_PRESET_48_3_1(LOCATION, CONTEXT)},
	{"48_4_1", BT_BAP_LC3_BROADCAST_PRESET_48_4_1(LOCATION, CONTEXT)},
	{"48_5_1", BT_BAP_LC3_BROADCAST_PRESET_48_5_1(LOCATION, CONTEXT)},
	{"48_6_1", BT_BAP_LC3_BROADCAST_PRESET_48_6_1(LOCATION, CONTEXT)},
	/* High-reliability presets */
	{"8_1_2", BT_BAP_LC3_BROADCAST_PRESET_8_1_2(LOCATION, CONTEXT)},
	{"8_2_2", BT_BAP_LC3_BROADCAST_PRESET_8_2_2(LOCATION, CONTEXT)},
	{"16_1_2", BT_BAP_LC3_BROADCAST_PRESET_16_1_2(LOCATION, CONTEXT)},
	{"16_2_2", BT_BAP_LC3_BROADCAST_PRESET_16_2_2(LOCATION, CONTEXT)},
	{"24_1_2", BT_BAP_LC3_BROADCAST_PRESET_24_1_2(LOCATION, CONTEXT)},
	{"24_2_2", BT_BAP_LC3_BROADCAST_PRESET_24_2_2(LOCATION, CONTEXT)},
	{"32_1_2", BT_BAP_LC3_BROADCAST_PRESET_32_1_2(LOCATION, CONTEXT)},
	{"32_2_2", BT_BAP_LC3_BROADCAST_PRESET_32_2_2(LOCATION, CONTEXT)},
	{"441_1_2", BT_BAP_LC3_BROADCAST_PRESET_441_1_2(LOCATION, CONTEXT)},
	{"441_2_2", BT_BAP_LC3_BROADCAST_PRESET_441_2_2(LOCATION, CONTEXT)},
	{"48_1_2", BT_BAP_LC3_BROADCAST_PRESET_48_1_2(LOCATION, CONTEXT)},
	{"48_2_2", BT_BAP_LC3_BROADCAST_PRESET_48_2_2(LOCATION, CONTEXT)},
	{"48_3_2", BT_BAP_LC3_BROADCAST_PRESET_48_3_2(LOCATION, CONTEXT)},
	{"48_4_2", BT_BAP_LC3_BROADCAST_PRESET_48_4_2(LOCATION, CONTEXT)},
	{"48_5_2", BT_BAP_LC3_BROADCAST_PRESET_48_5_2(LOCATION, CONTEXT)},
	{"48_6_2", BT_BAP_LC3_BROADCAST_PRESET_48_6_2(LOCATION, CONTEXT)},
};

BUILD_ASSERT(strlen(CONFIG_BROADCAST_CODE) <= BT_ISO_BROADCAST_CODE_SIZE,
	     "Invalid broadcast code");

BUILD_ASSERT(CONFIG_BT_ISO_TX_BUF_COUNT >= TOTAL_BUF_NEEDED,
	     "CONFIG_BT_ISO_TX_BUF_COUNT should be at least "
	     "BROADCAST_ENQUEUE_COUNT * CONFIG_BT_BAP_BROADCAST_SRC_STREAM_COUNT");

BUILD_ASSERT(NUM_STREAM_FILES == NUM_SUBGROUPS,
	     "NUM_STREAM_FILES should be equal to NUM_SUBGROUPS");


NET_BUF_POOL_FIXED_DEFINE(tx_pool,
			  TOTAL_BUF_NEEDED,
			  BT_ISO_SDU_BUF_SIZE(CONFIG_BT_ISO_TX_MTU),
			  CONFIG_BT_CONN_TX_USER_DATA_SIZE,
			  NULL);

struct broadcast_source_stream {
	struct bt_bap_stream stream;
	uint32_t seq_num;
	uint32_t sent_count;
	uint8_t *data;
	uint8_t *start;
	uint8_t *end;
	uint16_t sdu_len;
	uint16_t ch_spf;
	uint8_t ch_count;
};

static struct broadcast_source_stream streams[NUM_STREAMS];
static struct bt_bap_broadcast_source *broadcast_source;

static K_SEM_DEFINE(sem_started, 0, NUM_STREAMS);
static K_SEM_DEFINE(sem_stopped, 0, NUM_STREAMS);

#define BROADCAST_SOURCE_LIFETIME	120U /* seconds */

#define LC3_MIN_FRAME_BYTES	20
#define LC3_MAX_FRAME_BYTES     400

#define CHANNEL_COUNT 		1

uint8_t read_buffer[LC3_MAX_FRAME_BYTES * CHANNEL_COUNT];

/**
 * The following section contains the
 * LC3 binary format handler
 *
 * Rewritten handlers to work on uint8_t buffer from
 *
 * https://github.com/google/liblc3/tools/lc3bin.c
 *
 * Original license:
 */
/******************************************************************************
 *
 *  Copyright 2022 Google LLC
 *
 *  Licensed under the Apache License, Version 2.0 (the "License");
 *  you may not use this file except in compliance with the License.
 *  You may obtain a copy of the License at:
 *
 *  http://www.apache.org/licenses/LICENSE-2.0
 *
 *  Unless required by applicable law or agreed to in writing, software
 *  distributed under the License is distributed on an "AS IS" BASIS,
 *  WITHOUT WARRANTIES OR CONDITIONS OF ANY KIND, either express or implied.
 *  See the License for the specific language governing permissions and
 *  limitations under the License.
 *
 ******************************************************************************/

struct lc3bin_header {
	uint16_t file_id;
	uint16_t header_size;
	uint16_t srate_100hz;
	uint16_t bitrate_100bps;
	uint16_t channels;
	uint16_t frame_10us;
	uint16_t rfu;
	uint16_t nsamples_low;
	uint16_t nsamples_high;
};

int lc3bin_read_header(uint8_t **data, int *frame_us, int *srate_hz,
		       int *nchannels, int *nsamples)
{
	struct lc3bin_header hdr;

	memcpy(&hdr, *data, sizeof(hdr));

	*nchannels = hdr.channels;
	*frame_us = hdr.frame_10us * 10;
	*srate_hz = hdr.srate_100hz * 100;
	*nsamples = hdr.nsamples_low | (hdr.nsamples_high << 16);

	*data += sizeof(hdr);

	return sizeof(hdr);
}

int lc3bin_read_data(struct broadcast_source_stream *source_stream,
		     uint8_t **data, int nchannels, void *buffer)
{
	uint16_t nbytes;

	memcpy(&nbytes, *data, sizeof(nbytes));

	*data += sizeof(nbytes);

	memcpy(buffer, *data, nbytes);

	*data += nbytes;

	if (*data >= source_stream->end) {
		*data = source_stream->start;
		printk("End of LC3 array reached => looping., source stream> %p\n", source_stream);
	}

	return nbytes;
}
/****** end of lc3 handler code ******/

static void send_stream_data(struct broadcast_source_stream *source_stream)
{
	struct bt_bap_stream *stream = &source_stream->stream;
	struct net_buf *buf;
	int ret;

	buf = net_buf_alloc(&tx_pool, K_FOREVER);
	if (buf == NULL) {
		printk("Could not allocate buffer when sending on %p\n",
		       stream);
		return;
	}

	/* read one frame */
	ret = lc3bin_read_data(source_stream,
			       &(source_stream->data),
			       source_stream->ch_count,
			       read_buffer);

	if (ret < 0) {
		printk("ERROR READING LC3 DATA!\n");
		return;
	}

	net_buf_reserve(buf, BT_ISO_CHAN_SEND_RESERVE);
	net_buf_add_mem(buf, read_buffer, source_stream->sdu_len);

	ret = bt_bap_stream_send(stream, buf, source_stream->seq_num++);
	if (ret < 0) {
		/* This will end broadcasting on this stream. */
		printk("Unable to broadcast data on %p: %d\n", stream, ret);
		net_buf_unref(buf);
		return;
	}

	source_stream->sent_count++;
	if ((source_stream->sent_count % 1000U) == 0U) {
		printk("Stream %p: Sent %u total ISO packets\n",
			stream, source_stream->sent_count);
	}
}

static void stream_started_cb(struct bt_bap_stream *stream)
{
	struct broadcast_source_stream *source_stream =
		CONTAINER_OF(stream, struct broadcast_source_stream, stream);

	source_stream->seq_num   = 0;
	source_stream->sent_count = 0;
	printk("Stream %p started (ready to send audio)\n", stream);

	k_sem_give(&sem_started);
}

static void stream_stopped_cb(struct bt_bap_stream *stream, uint8_t reason)
{
	printk("Stream %p stopped (reason 0x%02X)\n", stream, reason);

	k_sem_give(&sem_stopped);
}

static void stream_sent_cb(struct bt_bap_stream *stream)
{
	struct broadcast_source_stream *source_stream =
		CONTAINER_OF(stream, struct broadcast_source_stream, stream);

	send_stream_data(source_stream);
}

static struct bt_bap_stream_ops stream_ops = {
	.started = stream_started_cb,
	.stopped = stream_stopped_cb,
	.sent    = stream_sent_cb,
};

static int get_lc3_preset(struct bt_bap_lc3_preset *preset, const char *preset_arg)
{
	for (size_t i = 0U; i < ARRAY_SIZE(lc3_broadcast_presets); i++) {
		if (strcmp(preset_arg, lc3_broadcast_presets[i].name) == 0) {
			*preset = lc3_broadcast_presets[i].preset;
			return 0;
		}
	}

	return -EINVAL;
}

void print_broadcast_audio_uri(const bt_addr_t *addr, uint32_t broadcast_id,
			       uint8_t *name, uint8_t sid)
{
	uint8_t addr_str[13];
	uint8_t name_base64[128];
	size_t name_base64_len;

	/* Address */
	snprintk(addr_str, sizeof(addr_str), "%02X%02X%02X%02X%02X%02X",
		 addr->val[5], addr->val[4], addr->val[3],
		 addr->val[2], addr->val[1], addr->val[0]);

	/* Name */
	base64_encode(name_base64, sizeof(name_base64), &name_base64_len, name, strlen(name));
	name_base64[name_base64_len + 1] = 0;

	/* Most fields hard coded for this demo */
	printk("Broadcast Audio URI string:\n");
	printk("\"BLUETOOTH:UUID:184F;BN:%s;SQ:1;AT:1;AD:%s;AS:%u;BI:%06X;PI:FFFF;NS:1;BS:1;;\"\n",
		 name_base64, addr_str, sid, broadcast_id);
}

static void set_subgroup_metadata(struct bt_audio_codec_cfg *sg_codec_cfg, uint8_t idx)
{
#if (SET_SUBGROUP_LANGUAGE_METADATA)
	if (strlen(subgroup_language[idx]) == BT_AUDIO_LANG_SIZE) {
		int err = bt_audio_codec_cfg_meta_set_lang(
				&sg_codec_cfg[idx], subgroup_language[idx]);

		if (err < 0) {
			printk("Failed to set language metadata for subgroup %d: %d\n",
				idx, err);
		}
	}
	else {
		printk("Invalid language string for subgroup %d: '%s'\n",
		       idx, subgroup_language[idx]);
	}
#endif /* SET_SUBGROUP_LANGUAGE_METADATA */
#if (SET_SUBGROUP_PARENTAL_METADATA)
	if (subgroup_parental[idx] <= BT_AUDIO_PARENTAL_RATING_AGE_18_OR_ABOVE) {
		int err = bt_audio_codec_cfg_meta_set_parental_rating(
				&sg_codec_cfg[idx], subgroup_parental[idx]);

		if (err < 0) {
			printk("Failed to set parental rating metadata for subgroup %d: %d\n",
			       idx, err);
		}
	}
	else {
		printk("Invalid parental rating for subgroup %d: %d\n",
		       idx, subgroup_parental[idx]);
	}
#endif /* SET_SUBGROUP_PARENTAL_METADATA */
#if (SET_SUBGROUP_BROADCASTNAME_METADATA)
	if (strlen(subgroup_broadcast_name[idx]) > 0) {
		int err = bt_audio_codec_cfg_meta_set_broadcast_name(
				&sg_codec_cfg[idx], subgroup_broadcast_name[idx],
				strlen(subgroup_broadcast_name[idx]));

		if (err < 0) {
			printk("Failed to set broadcast name metadata for subgroup %d: %d\n",
			       idx, err);
		}
	}
	else {
		printk("No broadcast name set for subgroup %d\n", idx);
	}
#endif /* SET_SUBGROUP_BROADCASTNAME_METADATA */
#if (SET_SUBGROUP_PROGRAMINFO_METADATA)
	if (strlen(subgroup_program_info[idx]) > 0) {
		int err = bt_audio_codec_cfg_meta_set_program_info(
				&sg_codec_cfg[idx], subgroup_program_info[idx],
				strlen(subgroup_program_info[idx]));

		if (err < 0) {
			printk("Failed to set program info metadata for subgroup %d: %d\n",
			       idx, err);
		}
	}
	else {
		printk("No program info set for subgroup %d\n", idx);
	}
#endif /* SET_SUBGROUP_PROGRAMINFO_METADATA */
#if (SET_SUBGROUP_ACTIVE_STATE_METADATA)
	if (subgroup_active_state[idx] <= BT_AUDIO_ACTIVE_STATE_ENABLED) {
		int err = bt_audio_codec_cfg_meta_set_audio_active_state(
				&sg_codec_cfg[idx], subgroup_active_state[idx]);

		if (err < 0) {
			printk("Failed to set active state metadata for subgroup %d: %d\n",
			       idx, err);
		}
	}
	else {
		printk("Invalid active state for subgroup %d: %d\n",
		       idx, subgroup_active_state[idx]);
	}
#endif /* SET_SUBGROUP_ACTIVE_STATE_METADATA */
#if (SET_SUBGROUP_ASST_LSTN_STRM_METADATA)
	if (subgroup_assisted_listening[idx] <= BT_AUDIO_ASSISTED_LISTENING_STREAM_UNSPECIFIED) {
		int err = bt_audio_codec_cfg_meta_set_assisted_listening_stream(
				&sg_codec_cfg[idx], subgroup_assisted_listening[idx]);

		if (err < 0) {
			printk("Failed to set assisted listening metadata for subgroup %d: %d\n",
			       idx, err);
		}
	}
	else {
		printk("Invalid assisted listening stream for subgroup %d: %d\n",
		       idx, subgroup_assisted_listening[idx]);
	}
#endif /* SET_SUBGROUP_ASST_LSTN_STRM_METADATA */
}

static int setup_broadcast_source(void)
{
	static struct bt_audio_codec_cfg subgroup_codec_cfg[NUM_SUBGROUPS];
	struct bt_bap_broadcast_source_subgroup_param subgroup_params[NUM_SUBGROUPS];
	struct bt_bap_broadcast_source_stream_param stream_params[NUM_STREAMS];
	struct bt_bap_broadcast_source_param create_param = { 0 };
	struct bt_bap_lc3_preset preset_lc3;
	const size_t streams_per_subgroup = ARRAY_SIZE(stream_params) /
					    ARRAY_SIZE(subgroup_params);

#if !defined(CONFIG_BT_BAP_AUDIO_CH_MONO)
	uint8_t left[] = {
		BT_AUDIO_CODEC_DATA(BT_AUDIO_CODEC_CFG_CHAN_ALLOC,
				    BT_BYTES_LIST_LE32(BT_AUDIO_LOCATION_FRONT_LEFT))
	};
	uint8_t right[] = {
		BT_AUDIO_CODEC_DATA(BT_AUDIO_CODEC_CFG_CHAN_ALLOC,
				    BT_BYTES_LIST_LE32(BT_AUDIO_LOCATION_FRONT_RIGHT))
	};
#if defined(CONFIG_BT_BAP_AUDIO_CH_LCR)
	uint8_t center[] = {
		BT_AUDIO_CODEC_DATA(BT_AUDIO_CODEC_CFG_CHAN_ALLOC,
				    BT_BYTES_LIST_LE32(BT_AUDIO_LOCATION_FRONT_CENTER))
	};
#endif
#endif
	int err;

	err = get_lc3_preset(&preset_lc3, BROADCAST_PRESET_ARG_NAME);
	if (err) {
		printk("Failed to get LC3 preset: %s\n", BROADCAST_PRESET_ARG_NAME);
		return err;
	}

	for (size_t i = 0; i < ARRAY_SIZE(subgroup_params); i++) {
		memcpy(&subgroup_codec_cfg[i], &preset_lc3.codec_cfg,
		       sizeof(struct bt_audio_codec_cfg));

#if defined(CONFIG_BT_BAP_AUDIO_CH_MONO)
		/* MONO is implicit if omitted */
		bt_audio_codec_cfg_unset_val(&subgroup_codec_cfg[i],
			BT_AUDIO_CODEC_CFG_CHAN_ALLOC);
#endif

		set_subgroup_metadata(subgroup_codec_cfg, i);

		subgroup_params[i].params_count = streams_per_subgroup;
		subgroup_params[i].params = stream_params + (i * streams_per_subgroup);
		subgroup_params[i].codec_cfg = &subgroup_codec_cfg[i];
	}

	for (size_t j = 0; j < ARRAY_SIZE(stream_params); j++) {
		int frame_us;
		int srate_hz;
		int nchannels;
		int nsamples;
		const size_t audio_file_index = (j / streams_per_subgroup);

		streams[j].data = (uint8_t *)lc3_audio[audio_file_index];

		printk("Reading LC3 audio header (%p)\n", streams[j].data);
		(void)lc3bin_read_header(&streams[j].data, &frame_us, &srate_hz,
					 &nchannels, &nsamples);

		streams[j].ch_count = nchannels;
		streams[j].ch_spf = (srate_hz / 1000) * (frame_us / 1000);

		printk("======================\n");
		printk("Stream %d: Frame size: %dus\n", j, frame_us);
		printk("Stream %d: Sample rate: %dHz\n", j, srate_hz);
		printk("Stream %d: Number of channels: %d\n", j, nchannels);
		printk("Stream %d: Number of samples: %d\n", j, nsamples);
		printk("Stream %d: Sample per frame: %d\n", j, streams[j].ch_spf);

		if (nchannels != AUDIO_CHANNELS_NUMBER) {
			printk("Stream %d: invalid number of channels (found %d, expected %d)\n",
			       j, nchannels, AUDIO_CHANNELS_NUMBER);

			return -EINVAL;
		}

		if (srate_hz != AUDIO_SAMPLE_RATE) {
			printk("Stream %d: invalid sample rate (found %d, expected %d)\n",
			       j, srate_hz, AUDIO_SAMPLE_RATE);

			return -EINVAL;
		}

		streams[j].sdu_len = preset_lc3.qos.sdu;

		/* Store position of start and end+1 of frame blocks */
		streams[j].start = streams[j].data;
		streams[j].end = streams[j].start +
				 ((nsamples / streams[j].ch_spf) *
				  (streams[j].sdu_len + 2));

		stream_params[j].stream = &streams[j].stream;

#if defined(CONFIG_BT_BAP_AUDIO_CH_MONO)
		stream_params[j].data = NULL;
		stream_params[j].data_len = 0;
#else
		switch (j % streams_per_subgroup) {
		case 0:
			stream_params[j].data = left;
			stream_params[j].data_len = sizeof(left);
			break;
		case 1:
			stream_params[j].data = right;
			stream_params[j].data_len = sizeof(right);
			break;
#if defined(CONFIG_BT_BAP_AUDIO_CH_LCR)
		case 2:
			stream_params[j].data = center;
			stream_params[j].data_len = sizeof(center);
			break;
#endif
		default:
			printk("Invalid stream index %d\n", j);
			return -EINVAL;
		}
#endif

		bt_bap_stream_cb_register(stream_params[j].stream, &stream_ops);
	}

	create_param.params_count = ARRAY_SIZE(subgroup_params);
	create_param.params = subgroup_params;
	create_param.qos = &preset_lc3.qos;
	create_param.encryption = (strlen(CONFIG_BROADCAST_CODE) > 0);
	create_param.packing = BT_ISO_PACKING_SEQUENTIAL;

	printk("Creating broadcast source with %d subgroups...\n", ARRAY_SIZE(subgroup_params));

	err = bt_bap_broadcast_source_create(&create_param, &broadcast_source);
	if (err) {
		printk("Failed to create broadcast source: %d\n", err);
		return err;
	}

	return 0;
}


int main(void)
{
	struct bt_le_ext_adv *adv;
	uint32_t broadcast_id = 0;
	int err;

	/* Check that the RGB PWM devices are present*/
	printk("Initialize RGB LED...\n");
	err = rgb_led_init();
	if (err) {
		printk("Error setting up RGB light!\n");
		return 0;
	}

	rgb_led_set(0, 0xff, 0);

	printk("Starting Auracast Broadcast Source demo (3-subgroups broadcast)\n");

	err = bt_enable(NULL);
	if (err) {
		printk("Bluetooth init failed (err %d)\n", err);
		rgb_led_set(0xff, 0, 0);

		return 0;
	}

	printk("Bluetooth initialized\n");

	/* Broadcast Audio Streaming Endpoint advertising data */
	NET_BUF_SIMPLE_DEFINE(ad_buf, BT_UUID_SIZE_16 + BT_AUDIO_BROADCAST_ID_SIZE);
	NET_BUF_SIMPLE_DEFINE(base_buf, 256);

	/* Create a non-connectable non-scannable advertising set */
	err = bt_le_ext_adv_create(BT_LE_EXT_ADV_CUSTOM, NULL, &adv);
	if (err) {
		printk("Failed to create extended advertising set (err %d)\n", err);
		rgb_led_set(0xff, 0, 0);

		return 0;
	}

	printk("Extended advertising created\n");

	/* Set periodic advertising parameters */
	err = bt_le_per_adv_set_param(adv, BT_BAP_PER_ADV_PARAM_BROADCAST_FAST);
	if (err) {
		printk("Failed to set periodic advertising params (err %d)\n", err);
		rgb_led_set(0xff, 0, 0);

		return 0;
	}

	printk("Creating broadcast source\n");
	err = setup_broadcast_source();
	if (err) {
		printk("setup_broadcast_source failed (err %d)\n", err);
		rgb_led_set(0xff, 0, 0);

		return 0;
	}

	uint8_t hwid[3] = { 0 };
	if (hwinfo_get_device_id(hwid, sizeof(hwid)) == sizeof(hwid)) {
		broadcast_id |= (hwid[0] << 16) | (hwid[1] << 8) | hwid[2];
	} else {
		broadcast_id = 0xABCDEF;
	}

	/* Setup extended advertising data */
	net_buf_simple_add_le16(&ad_buf, BT_UUID_BROADCAST_AUDIO_VAL);
	net_buf_simple_add_le24(&ad_buf, broadcast_id);

	struct bt_data ext_ad[3];
	ext_ad[0] = (struct bt_data)BT_DATA(BT_DATA_BROADCAST_NAME,
					    BROADCAST_NAME,
					    strlen(BROADCAST_NAME));
	ext_ad[1].type = BT_DATA_SVC_DATA16;
	ext_ad[1].data_len = ad_buf.len;
	ext_ad[1].data = ad_buf.data;
	ext_ad[2] = (struct bt_data)BT_DATA(BT_DATA_NAME_COMPLETE, CONFIG_BT_DEVICE_NAME,
		sizeof(CONFIG_BT_DEVICE_NAME) - 1);

	err = bt_le_ext_adv_set_data(adv, ext_ad, ARRAY_SIZE(ext_ad), NULL, 0);
	if (err) {
		printk("Failed to set ext advertising data (err %d)\n", err);
		rgb_led_set(0xff, 0, 0);

		return 0;
	}

	/* Setup periodic advertising data */
	err = bt_bap_broadcast_source_get_base(broadcast_source, &base_buf);
	if (err) {
		printk("Failed to get BASE data (err %d)\n", err);
		rgb_led_set(0xff, 0, 0);

		return 0;
	}

	struct bt_data per_ad;
	per_ad.type = BT_DATA_SVC_DATA16;
	per_ad.data_len = base_buf.len;
	per_ad.data = base_buf.data;
	printk("PA data len = %d\n", per_ad.data_len);

	err = bt_le_per_adv_set_data(adv, &per_ad, 1);
	if (err) {
		printk("Failed to set periodic advertising data (err %d)\n", err);
		rgb_led_set(0xff, 0, 0);

		return 0;
	}

	/* Start extended advertising */
	err = bt_le_ext_adv_start(adv, BT_LE_EXT_ADV_START_DEFAULT);
	if (err) {
		printk("Failed to start extended advertising (err %d)\n", err);
		rgb_led_set(0xff, 0, 0);

		return 0;
	}

	/* Enable Periodic Advertising */
	err = bt_le_per_adv_start(adv);
	if (err) {
		printk("Failed to start periodic advertising (err %d)\n", err);
		rgb_led_set(0xff, 0, 0);

		return 0;
	}

	/* Print Broadcast Audio URI to log */
	struct bt_le_ext_adv_info advInfo;
	bt_le_ext_adv_get_info(adv, &advInfo);
	print_broadcast_audio_uri(&advInfo.addr->a, broadcast_id, BROADCAST_NAME, 0);

	printk("Advertising started (Extended + Periodic)\n");

	err = bt_bap_broadcast_source_start(broadcast_source, adv);
	if (err != 0) {
		printk("Unable to start broadcast source: %d\n", err);
		rgb_led_set(0xff, 0, 0);

		return 0;
	}

	printk("Broadcast source started, waiting for streams to be ready...\n");

	for (size_t i = 0; i < NUM_STREAMS; i++) {
		k_sem_take(&sem_started, K_FOREVER);
	}

	printk("All BIS streams started. Beginning audio transmission.\n");

	for (size_t i = 0; i < NUM_STREAMS; i++) {
		for (uint8_t j = 0; j < BROADCAST_ENQUEUE_COUNT; j++) {
			stream_sent_cb(&streams[i].stream);
		}
	}

	printk("Audio streaming in progress on all %d streams.\n", NUM_STREAMS);
	rgb_led_set(0, 0, 0xff);

	return 0;
}
```

## src/lc3_audio.h
```c
/**
 * LC3 audio data
 */

#ifndef LC3_AUDIO_H
#define LC3_AUDIO_H


#define BROADCAST_NAME 		"Broadcast Audio"

#define NUM_STREAM_FILES	3

#define STREAM1_FILENAME 	"stream_filename_1.lc3.inc"
#define STREAM2_FILENAME 	"stream_filename_2.lc3.inc"
#define STREAM3_FILENAME 	"stream_filename_3.lc3.inc"

static const uint8_t stream1_data[] = {
	#include STREAM1_FILENAME
};

static const uint8_t stream2_data[] = {
	#include STREAM2_FILENAME
};

static const uint8_t stream3_data[] = {
	#include STREAM3_FILENAME
};

static const uint8_t *lc3_audio[] = {
	stream1_data,
	stream2_data,
	stream3_data
};


#define SET_SUBGROUP_LANGUAGE_METADATA		true
#define SET_SUBGROUP_PARENTAL_METADATA		true
#define SET_SUBGROUP_BROADCASTNAME_METADATA	false
#define SET_SUBGROUP_PROGRAMINFO_METADATA	false
#define SET_SUBGROUP_ACTIVE_STATE_METADATA	false
#define SET_SUBGROUP_ASST_LSTN_STRM_METADATA	false

const uint8_t *subgroup_language[] = {
	"eng",
	"fra",
	"spa"
};

enum bt_audio_parental_rating subgroup_parental[] = {
	BT_AUDIO_PARENTAL_RATING_AGE_ANY,
	BT_AUDIO_PARENTAL_RATING_AGE_5_OR_ABOVE,
	BT_AUDIO_PARENTAL_RATING_AGE_7_OR_ABOVE
};

const uint8_t *subgroup_broadcast_name[] = {
	"Sample-1",
	"Sample-2",
	"Sample-3"
};

const uint8_t *subgroup_program_info[] = {
	"Prg_info_1",
	"Prg_info_2",
	"Prg_info_3"
};

enum bt_audio_active_state subgroup_active_state[] = {
	BT_AUDIO_ACTIVE_STATE_DISABLED,
	BT_AUDIO_ACTIVE_STATE_DISABLED,
	BT_AUDIO_ACTIVE_STATE_DISABLED
};

enum bt_audio_assisted_listening_stream subgroup_assisted_listening[] = {
	BT_AUDIO_ASSISTED_LISTENING_STREAM_UNSPECIFIED,
	BT_AUDIO_ASSISTED_LISTENING_STREAM_UNSPECIFIED,
	BT_AUDIO_ASSISTED_LISTENING_STREAM_UNSPECIFIED
};

#endif /* LC3_AUDIO_H */
```
